#include <dt-bindings/zmk/matrix_transform.h>

/ {
    chosen {
        zmk,kscan = &kscan0;
    };

    kscan0: kscan_0 {
        compatible = "zmk,kscan-gpio-matrix";
        wakeup-source;

        diode-direction = "col2row";

        col-gpios
            = <&pro_micro 21 GPIO_ACTIVE_HIGH> // Col 0
            , <&pro_micro 20 GPIO_ACTIVE_HIGH> // Col 1
            , <&pro_micro 19 GPIO_ACTIVE_HIGH> // Col 2
            , <&pro_micro 18 GPIO_ACTIVE_HIGH> // Col 3
            , <&pro_micro 15 GPIO_ACTIVE_HIGH> // Col 4 (Mapped to pin 113 / P1.13)
            , <&pro_micro 4  GPIO_ACTIVE_HIGH> // Col 5
            , <&pro_micro 15 GPIO_ACTIVE_HIGH> // Col 6 (adjust if needed, or keep standard)
            ;

        row-gpios
            = <&pro_micro 5  (GPIO_ACTIVE_HIGH | GPIO_PULL_DOWN)>
            , <&pro_micro 6  (GPIO_ACTIVE_HIGH | GPIO_PULL_DOWN)>
            , <&pro_micro 7  (GPIO_ACTIVE_HIGH | GPIO_PULL_DOWN)>
            , <&pro_micro 8  (GPIO_ACTIVE_HIGH | GPIO_PULL_DOWN)>
            , <&pro_micro 9  (GPIO_ACTIVE_HIGH | GPIO_PULL_DOWN)>
            ;
    };
};